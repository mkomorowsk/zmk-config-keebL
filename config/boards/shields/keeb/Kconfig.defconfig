## config/boards/shields/keeb/Kconfig.defconfig
```kconfig
if SHIELD_keeb_LEFT || SHIELD_keeb_RIGHT

config ZMK_KEYBOARD_NAME
    default "keeb"

config ZMK_SPLIT
    default y

if SHIELD_keeb_LEFT

config ZMK_SPLIT_ROLE_CENTRAL
    default y

endif # SHIELD_keeb_LEFT

endif # SHIELD_keeb_LEFT || SHIELD_keeb_RIGHT
```

## config/boards/shields/keeb/Kconfig.shield
```kconfig
config SHIELD_keeb_LEFT
    def_bool $(shields_list_contains,keeb_left)

config SHIELD_keeb_RIGHT
    def_bool $(shields_list_contains,keeb_right)
```

## config/boards/shields/keebl/Kconfig.defconfig
```kconfig
if SHIELD_KEEBL_LEFT || SHIELD_KEEBL_RIGHT

config ZMK_KEYBOARD_NAME
    default "keebL"

config ZMK_SPLIT
    default y

if SHIELD_KEEBL_LEFT

config ZMK_SPLIT_ROLE_CENTRAL
    default y

endif # SHIELD_KEEBL_LEFT

endif # SHIELD_KEEBL_LEFT || SHIELD_KEEBL_RIGHT
```

## config/boards/shields/keebl/Kconfig.shield
```kconfig
config SHIELD_KEEBL_LEFT
    def_bool $(shields_list_contains,keebl_left)

config SHIELD_KEEBL_RIGHT
    def_bool $(shields_list_contains,keebl_right)
```

## config/west.yml
```yaml
manifest:
  remotes:
    - name: zmkfirmware
      url-base: https://github.com/zmkfirmware

    # zmk-unicode: community module for Unicode character input.
    # Used for Polish diacritics (ż ś ć) in macros.
    # See: https://github.com/nickcoutsos/zmk-unicode
    #
    # STATUS: Polish macros currently use ASCII approximations.
    # To enable real diacritics:
    #   1. Uncomment the zmk-unicode remote and project below.
    #   2. Replace ASCII sequences in macro_juz / macro_jeszcze / macro_czesc
    #      with the zmk-unicode syntax from that module's README.
    #   3. On Windows: ensure Unicode Alt+numpad input is enabled in the registry.
    - name: nickcoutsos
      url-base: https://github.com/nickcoutsos

  projects:
    - name: zmk
      remote: zmkfirmware
      revision: main
      import: app/west.yml

    # Uncomment to enable zmk-unicode:
    # - name: zmk-unicode
    #   remote: nickcoutsos
    #   revision: main

  self:
    path: config
```

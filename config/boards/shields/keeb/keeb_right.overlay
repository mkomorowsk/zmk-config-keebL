/* keebL - Seeed XIAO BLE RIGHT HALF
 * Hardware: 3 rows x 8 cols, COL2ROW diodes
 *
 * XIAO BLE pin mapping (D-number -> nRF GPIO):
 *   D0 -> P0.02   D1 -> P0.03   D2 -> P0.28   D3 -> P0.29
 *   D4 -> P0.04   D5 -> P0.05   D6 -> P1.11   D7 -> P1.12
 *   D8 -> P1.13   D9 -> P1.14   D10 -> P1.15
 *
 * col pins (D0-D7):  &xiao_d 0..7
 * row pins (D8-D10): &xiao_d 8..10
 *
 * This half is the PERIPHERAL (BLE slave).
 * Rows 0 and 1 only use cols 2-7 (cols 0-1 unused per transform).
 */

#include "keeb.dtsi"

/* Shift this half's matrix columns 0-7 to 8-15 of the shared transform,
 * so right-half keys produce keymap positions 6-11, 18-23 and 32-39. */
&default_transform {
    col-offset = <8>;
};

/ {
    chosen {
        zmk,kscan = &kscan0;
    };

    kscan0: kscan {
        compatible = "zmk,kscan-gpio-matrix";
        diode-direction = "col2row";

        col-gpios
            = <&xiao_d 0 GPIO_ACTIVE_HIGH>   /* col 0 - D0 / P0.02 (unused in row 0 & 1) */
            , <&xiao_d 1 GPIO_ACTIVE_HIGH>   /* col 1 - D1 / P0.03 (unused in row 0 & 1) */
            , <&xiao_d 3 GPIO_ACTIVE_HIGH>   /* col 2 - D2 / P0.28 */
            , <&xiao_d 2 GPIO_ACTIVE_HIGH>   /* col 3 - D3 / P0.29 */
            , <&xiao_d 4 GPIO_ACTIVE_HIGH>   /* col 4 - D4 / P0.04 */
            , <&xiao_d 5 GPIO_ACTIVE_HIGH>   /* col 5 - D5 / P0.05 */
            , <&xiao_d 7 GPIO_ACTIVE_HIGH>   /* col 6 - D6 / P1.11 */
            , <&xiao_d 6 GPIO_ACTIVE_HIGH>   /* col 7 - D7 / P1.12 */
            ;

        row-gpios
            = <&xiao_d 8  (GPIO_ACTIVE_HIGH | GPIO_PULL_DOWN)>  /* row 0 - D8  / P1.13 */
            , <&xiao_d 9  (GPIO_ACTIVE_HIGH | GPIO_PULL_DOWN)>  /* row 1 - D9  / P1.14 */
            , <&xiao_d 10 (GPIO_ACTIVE_HIGH | GPIO_PULL_DOWN)>  /* row 2 - D10 / P1.15 */
            ;
    };
};
